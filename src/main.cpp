// Inkling - hardware smoke test.
//
// Draws one static board screen with fake data on a Waveshare 2.9" (B)
// three-colour panel, then stops. No WiFi, no polling, no JIRA. The point is
// to find out how the layout and the red actually look on glass.

#include <GxEPD2_3C.h>
// Custom sizes: Adafruit ships Free* at 9/12/18/24pt only, and 9pt was too
// heavy for a 128px-tall panel. Generated by tools/ttf2gfx.py - cap height
// drops 12px -> 10px and "PROJ-4821" narrows from 99px to 72px.
#include "fonts/InkMonoBold14.h"
#include "fonts/InkSansBold14.h"

// --- panel -----------------------------------------------------------------
// Waveshare's 2.9" (B) has shipped under more than one controller. If the
// screen comes up blank or scrambled, swap to the other class below - that is
// the first thing to try, not a wiring problem.
#define PANEL_Z13C 1          // 0 -> use GDEM029C90 instead

#if PANEL_Z13C
  using PanelDriver = GxEPD2_290_Z13c;     // GDEH029Z13
#else
  using PanelDriver = GxEPD2_290_C90c;     // GDEM029C90
#endif

// Wiring on this build is the stock GxEPD2 ESP32 pinout. SPI is still begun
// explicitly in setup() so the wiring is stated in one place rather than
// inherited from a library default.
#define PIN_CS   5     // D5
#define PIN_DC   17    // TX2
#define PIN_RST  16    // RX2
#define PIN_BUSY 4     // D4
#define PIN_SCK  18    // D18
#define PIN_MOSI 23    // D23
#define PIN_MISO 19    // unused by e-paper, but SPI.begin() wants a pin

// Button to GND on GPIO27, using the internal pull-up so no resistor is needed.
// Chosen to dodge the flash pins (6-11), the boot straps (0/2/12/15) and the
// input-only pins (34-39), which have no pull-up.
#define PIN_BUTTON 27
// The button's other leg goes to GPIO26 rather than a GND header. An output pin
// held LOW is electrically ground for a switch drawing microamps through the
// internal pull-up, and it saves fighting two wires into one GND pin.
#define PIN_BUTTON_GND 26
// Onboard blue LED, used as the acknowledgement channel. A ~17.8 s refresh
// gives no sign it heard you, which is what makes people press again - so the
// LED says "heard you, working" for the whole draw.
#define PIN_LED 2

GxEPD2_3C<PanelDriver, PanelDriver::HEIGHT> display(
    PanelDriver(PIN_CS, PIN_DC, PIN_RST, PIN_BUSY));

// --- layout ----------------------------------------------------------------
static const int W = 296, H = 128;
static const int PAD = 6, TOP = 2, ROW_H = 23, MAX_ROWS = 5;
static const int NUM_W     = 24;   // width of "N) " in the mono face
static const int KEY_X     = PAD + NUM_W;  // key column; line 2 indents to match
static const int KEY_BASE  = 11;   // baseline of the ticket key, row-relative
static const int LINE2_TOP = 13;   // top of the PR line (built-in font is top-left)
static const int FOOT_TOP  = 119;
static const int PAGE_SIZE = 5;

// Demo value so both pages are visible without waiting. In real use this wants
// to be far longer - every flip costs a ~17.8 s full refresh with the flashing,
// so paging every couple of minutes would mean a near-permanently blinking desk.
// Paging is on demand, not on a timer. A timer would repaint the panel to tell
// you nothing new, which is the one thing this display cannot afford.
static const uint32_t LONG_PRESS_MS = 800;

// --- fake data -------------------------------------------------------------
enum PrState { PR_CHANGES, PR_READY, PR_REVIEW, PR_NONE, PR_MERGED, PR_CLOSED };

struct Row {
  const char* key;
  const char* status;
  const char* repo;
  int         pr;        // 0 = none
  PrState     state;
};

// Already sorted the way the poller would sort it: primary statuses first,
// then by what needs you. Secondary (Ready for QA) only fills leftover rows.
static const Row ROWS[] = {
  { "PROJ-4821", "Code Review",          "frontend", 2410, PR_CHANGES },
  { "PROJ-4790", "Waiting to be Merged", "frontend", 2387, PR_READY   },
  { "PROJ-4815", "In Progress",          "frontend", 2402, PR_REVIEW  },
  { nullptr,     "no ticket",            "frontend", 2415, PR_REVIEW  },
  { "PROJ-4766", "Code Review",          "promo",      1192, PR_REVIEW  },
  { "PROJ-4302", "Ready for QA",         "ui",           0, PR_NONE    },
  { "PROJ-4588", "Testing",              "frontend", 2301, PR_REVIEW  },
  { "PROJ-4801", "In Progress",          "ui",           0, PR_NONE    },
};
static const int ROW_COUNT = sizeof(ROWS) / sizeof(ROWS[0]);

static const char* prLabel(PrState s) {
  switch (s) {
    case PR_CHANGES: return "changes requested";
    case PR_READY:   return "ready to merge";
    case PR_REVIEW:  return "code review";
    case PR_MERGED:  return "merged";
    case PR_CLOSED:  return "closed";
    default:         return "no pull request";
  }
}

// red means your move; everything else is waiting on someone, or done
static uint16_t prColor(PrState s) {
  return (s == PR_CHANGES || s == PR_READY) ? GxEPD_RED : GxEPD_BLACK;
}

// --- button ----------------------------------------------------------------
// Polled with a stable-sample debounce, not an interrupt. A CHANGE ISR has to
// digitalRead() to learn which edge fired, and on a bouncing contact that read
// can land after the pin has flipped back - so releases get swallowed and taps
// go missing. Presses during a redraw are discarded by design anyway, which was
// the only thing the ISR was buying.
static const uint32_t SAMPLE_MS        = 5;
static const uint8_t  DEBOUNCE_SAMPLES = 4;     // 4 x 5 ms = 20 ms stable

enum ButtonEvent { BTN_NONE = 0, BTN_TAP, BTN_HOLD };

struct Button {
  bool     level  = HIGH;        // accepted, debounced level
  bool     cand   = HIGH;        // level currently being timed for stability
  uint8_t  count  = DEBOUNCE_SAMPLES;
  uint32_t downAt = 0;
};

// "Heard you, but deliberately doing nothing" - otherwise an ignored press is
// indistinguishable from a missed one.
static void blinkAck() {
  for (int i = 0; i < 2; i++) {
    digitalWrite(PIN_LED, HIGH); delay(60);
    digitalWrite(PIN_LED, LOW);  delay(90);
  }
}

static ButtonEvent pollButton(Button& b) {
  const bool raw = digitalRead(PIN_BUTTON);

  if (raw != b.cand) { b.cand = raw; b.count = 0; return BTN_NONE; }
  if (b.count >= DEBOUNCE_SAMPLES) return BTN_NONE;      // already accepted
  if (++b.count < DEBOUNCE_SAMPLES) return BTN_NONE;     // not stable yet
  if (b.cand == b.level)            return BTN_NONE;     // no actual change

  b.level = b.cand;
  const uint32_t now = millis();

  if (b.level == LOW) {
    b.downAt = now;
    Serial.printf("[%8lu] down\n", (unsigned long)now);
    return BTN_NONE;
  }

  const uint32_t held = now - b.downAt;
  const bool hold = held >= LONG_PRESS_MS;
  Serial.printf("[%8lu] up after %4lu ms -> %s\n",
                (unsigned long)now, (unsigned long)held, hold ? "HOLD" : "TAP");
  return hold ? BTN_HOLD : BTN_TAP;
}

// After a redraw, resync to whatever the pin is doing now, so a button held
// through those 17.8 s does not surface as a phantom event afterwards.
static void resyncButton(Button& b) {
  b.level = b.cand = digitalRead(PIN_BUTTON);
  b.count = DEBOUNCE_SAMPLES;
}

// --- GitHub mark -----------------------------------------------------------
// Traced from GitHub's favicon, which is a filled disc with the Octocat knocked
// out of it - the sprite is the inverse of that file's alpha channel.
static const char* const OCTOCAT[25] = {
  "..####..........####.", "..##################.", "..##################.",
  "..##################.", "..##################.", ".####################",
  ".####################", ".####################", ".####################",
  ".####################", ".####################", ".####################",
  "..##################.", "...################..", "....##############...",
  "#.....##########.....", "##......######.......", ".##....########......",
  "..##...########......", "..#############......", ".......########......",
  ".......########......", ".......########......", ".......########......",
  "......##########....."
};
static const int OS = 3, OX = 16, OY = 26;

// --- 9x9 state icons -------------------------------------------------------
static const char* const ICON_REVIEW[9] = {
  "..#####..", ".#.....#.", "#.......#", "#.......#", "#.......#",
  "#.......#", "#.......#", ".#.....#.", "..#####.."
};
static const char* const ICON_CHANGES[9] = {
  "..#####..", ".#######.", "#########", "#########", "#.......#",
  "#########", "#########", ".#######.", "..#####.."
};
static const char* const ICON_READY[9] = {
  ".......##", "......###", ".....###.", "#...###..", "##.###...",
  "#####....", ".###.....", "..#......", "........."
};
static const char* const ICON_MERGED[9] = {
  "..#####..", ".#######.", "#########", "#########", "#########",
  "#########", "#########", ".#######.", "..#####.."
};
static const char* const ICON_CLOSED[9] = {
  "##.....##", "###...###", ".###.###.", "..#####..", "...###...",
  "..#####..", ".###.###.", "###...###", "##.....##"
};
static const char* const ICON_NONE[9] = {
  ".........", ".........", ".........", "#########", "#########",
  ".........", ".........", ".........", "........."
};

static const char* const* iconFor(PrState s) {
  switch (s) {
    case PR_CHANGES: return ICON_CHANGES;
    case PR_READY:   return ICON_READY;
    case PR_REVIEW:  return ICON_REVIEW;
    case PR_MERGED:  return ICON_MERGED;
    case PR_CLOSED:  return ICON_CLOSED;
    default:         return ICON_NONE;
  }
}

static void drawIcon(const char* const* art, int x, int y, uint16_t colour) {
  for (int r = 0; r < 9; r++)
    for (int c = 0; c < 9; c++)
      if (art[r][c] == '#') display.drawPixel(x + c, y + r, colour);
}

// --- helpers ---------------------------------------------------------------
static int textWidth(const char* s) {
  int16_t bx, by; uint16_t bw, bh;
  display.getTextBounds(s, 0, 0, &bx, &by, &bw, &bh);
  return bw;
}

static void drawAt(const char* s, int x, int baseline, uint16_t colour) {
  display.setTextColor(colour);
  display.setCursor(x, baseline);
  display.print(s);
}

static void drawRight(const char* s, int xRight, int baseline, uint16_t colour) {
  drawAt(s, xRight - textWidth(s), baseline, colour);
}

// Clip to a pixel budget using the font currently selected. FreeMono9pt7b
// advances 11px per glyph against the preview's 6.3px, which is what pushed
// the PR label straight through the repo column on the first build.
static void clipTo(char* s, int maxPx) {
  while (*s && textWidth(s) > maxPx) s[strlen(s) - 1] = '\0';
}

// --- the board -------------------------------------------------------------
static void drawBoard(int page) {
  const int pages = (ROW_COUNT + PAGE_SIZE - 1) / PAGE_SIZE;
  const int first = page * PAGE_SIZE;
  const int count = min(PAGE_SIZE, ROW_COUNT - first);

  display.setFullWindow();
  display.firstPage();
  do {
    display.fillScreen(GxEPD_WHITE);

    for (int i = 0; i < count; i++) {
      const Row& row = ROWS[first + i];
      const int top = TOP + i * ROW_H;

      // line 1 - index, ticket key, then JIRA status in a different face
      display.setFont(&InkMonoBold14);
      char num[6];
      snprintf(num, sizeof(num), "%d)", first + i + 1);
      drawAt(num, PAD, top + KEY_BASE, GxEPD_BLACK);

      const char* key = row.key ? row.key : "-";
      drawAt(key, KEY_X, top + KEY_BASE, GxEPD_BLACK);
      const int keyW = textWidth(key);

      display.setFont(&InkSansBold14);
      drawAt(row.status, KEY_X + keyW + 8, top + KEY_BASE, GxEPD_BLACK);

      // line 2 - icon, then the single most recent PR. Built-in 5x7 rather
      // than FreeMono9pt7b: at 6px per glyph it leaves room for the repo.
      const uint16_t colour = prColor(row.state);
      drawIcon(iconFor(row.state), KEY_X, top + LINE2_TOP, colour);

      display.setFont(nullptr);
      display.setTextSize(1);

      char repo[24];
      snprintf(repo, sizeof(repo), "%s", row.repo);
      const int repoW = textWidth(repo);
      const int repoX = W - PAD - repoW;

      char line[48];
      if (row.pr) snprintf(line, sizeof(line), "#%d  %s", row.pr, prLabel(row.state));
      else        snprintf(line, sizeof(line), "%s", prLabel(row.state));

      const int lineX = KEY_X + 14;
      clipTo(line, repoX - lineX - 10);
      drawAt(line, lineX, top + LINE2_TOP, colour);
      drawAt(repo, repoX, top + LINE2_TOP, GxEPD_BLACK);
    }

    // footer: item count, and how stale the data is
    display.setFont(nullptr);
    display.setTextSize(1);
    char foot[48];
    snprintf(foot, sizeof(foot), "%d-%d of %d   page %d/%d",
             first + 1, first + count, ROW_COUNT, page + 1, pages);
    drawAt(foot, PAD, FOOT_TOP, GxEPD_BLACK);
    drawRight("updated 3m", W - PAD, FOOT_TOP, GxEPD_BLACK);

  } while (display.nextPage());
}

// Summoned by hold, never by a clock. Three screens total: the board (default),
// ALL CLEAR when the poller sends nothing, and this - which you ask for when you
// do not want to know. The phrase advances each time you enter it.
struct Phrase { const char* a; const char* b; };
static const Phrase PHRASES[] = {
  { "The backlog is infinite.",  "You are not."           },
  { "Nothing is on fire.",       "Probably."              },
  { "It will still be broken",   "on Monday."             },
  { "No one ever wished for",    "one more code review."  },
  { "Go outside.",               "The diff will keep."    },
};
static const int PHRASE_COUNT = sizeof(PHRASES) / sizeof(PHRASES[0]);

static void drawCentred(const char* s, int baseline, uint16_t colour) {
  drawAt(s, (W - textWidth(s)) / 2, baseline, colour);
}

static void drawOffDuty(int idx) {
  const Phrase& p = PHRASES[idx % PHRASE_COUNT];
  display.setFullWindow();
  display.firstPage();
  do {
    display.fillScreen(GxEPD_WHITE);

    display.setFont(&InkSansBold14);
    drawCentred(p.a, 54, GxEPD_BLACK);
    drawCentred(p.b, 76, GxEPD_RED);

    display.fillRect((W - 64) / 2, 88, 64, 2, GxEPD_RED);

    display.setFont(nullptr);
    display.setTextSize(1);
    const char* hint = "hold to come back";
    drawAt(hint, (W - textWidth(hint)) / 2, FOOT_TOP, GxEPD_BLACK);
  } while (display.nextPage());
}

// Shown when the poller reports nothing open. Data-driven in the real build;
// flip DEMO_EMPTY to 1 to see it on the bench.
#define DEMO_EMPTY 0
// Boot straight into the off-duty screen so it can be seen before the button
// is wired. Set back to 0 once there is a button to hold.
#define DEMO_OFFDUTY 0
static void drawAllClear() {
  display.setFullWindow();
  display.firstPage();
  do {
    display.fillScreen(GxEPD_WHITE);
    for (int r = 0; r < 25; r++)
      for (int c = 0; c < 21; c++)
        if (OCTOCAT[r][c] == '#')
          display.fillRect(OX + c * OS, OY + r * OS, OS, OS, GxEPD_BLACK);

    display.setFont(&InkSansBold14);
    drawAt("ALL CLEAR", 96, 52, GxEPD_BLACK);
    display.setFont(nullptr);
    display.setTextSize(1);
    drawAt("nothing waiting on you", 96, 60, GxEPD_BLACK);
    drawRight("updated 3m", W - PAD, FOOT_TOP, GxEPD_BLACK);
  } while (display.nextPage());
}

void setup() {
  Serial.begin(115200);
  delay(300);
  Serial.println();
  Serial.println("Inkling smoke test");
  Serial.printf("panel %dx%d, driver %s\n", W, H, PANEL_Z13C ? "Z13c" : "C90c");

  display.init(115200, true, 2, false);

  // State the bus pins explicitly. Must come after init(), which starts SPI.
  SPI.end();
  SPI.begin(PIN_SCK, PIN_MISO, PIN_MOSI, PIN_CS);
  Serial.printf("spi: sck=%d mosi=%d cs=%d dc=%d rst=%d busy=%d\n",
                PIN_SCK, PIN_MOSI, PIN_CS, PIN_DC, PIN_RST, PIN_BUSY);

  display.setRotation(1);                       // native is portrait
  display.setTextWrap(false);

  pinMode(PIN_BUTTON_GND, OUTPUT);
  digitalWrite(PIN_BUTTON_GND, LOW);      // must settle before the pin-change ISR
  pinMode(PIN_BUTTON, INPUT_PULLUP);
  pinMode(PIN_LED, OUTPUT);
  delay(5);
  Serial.printf("button: GPIO%d <-> GPIO%d (driven low), idle reads %s\n",
                PIN_BUTTON, PIN_BUTTON_GND,
                digitalRead(PIN_BUTTON) ? "HIGH (good)" : "LOW (stuck/shorted)");

  Serial.printf("%d items, %d per page\n", ROW_COUNT, PAGE_SIZE);
  Serial.println("button on GPIO27: tap = next page, hold = off duty");
}

void loop() {
  static Button btn;
  static int  page      = 0;
  static int  phrase    = DEMO_OFFDUTY ? 0 : -1;   // first hold shows PHRASES[0]
  static bool offDuty   = DEMO_OFFDUTY;
  static bool needsDraw = true;                    // draw once on boot
  const int pages = (ROW_COUNT + PAGE_SIZE - 1) / PAGE_SIZE;

  switch (pollButton(btn)) {
    case BTN_TAP:
      if (offDuty) {
        // hold is the only way out, exactly as the screen says. No redraw, so a
        // stray tap never costs 17.8 s of flashing.
        Serial.println("           tap ignored (off duty)");
        blinkAck();
      } else {
        page = (page + 1) % pages;
        needsDraw = true;
        Serial.printf("           -> page %d/%d\n", page + 1, pages);
      }
      break;

    case BTN_HOLD:
      offDuty = !offDuty;
      if (offDuty) phrase = (phrase + 1) % PHRASE_COUNT;   // fresh line each time
      else         page = 0;                               // always back to page 1
      needsDraw = true;
      Serial.printf("           -> %s\n", offDuty ? "off duty" : "board (page 1)");
      break;

    default:
      break;
  }

  if (needsDraw) {
    needsDraw = false;
    digitalWrite(PIN_LED, HIGH);          // lit for the whole redraw
    const uint32_t t0 = millis();
    if (offDuty)         drawOffDuty(phrase);
    else if (DEMO_EMPTY) drawAllClear();
    else                 drawBoard(page);
    Serial.printf("           done in %lu ms\n", (unsigned long)(millis() - t0));
    display.hibernate();
    digitalWrite(PIN_LED, LOW);           // screen is settled and readable
    resyncButton(btn);
  }

  delay(SAMPLE_MS);
}
